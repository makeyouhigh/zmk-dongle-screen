## dts/bindings/behaviors/zmk,behavior-screen-rotate.yaml
```yaml
description: Toggle the dongle screen orientation by 180 degrees
compatible: "zmk,behavior-screen-rotate"
include: zero_param.yaml
```
